## drivers/misc/mediatek/broadcast/oneseg/Kconfig
```kconfig
#
# Broadcast Device Driver Support
#

menu "LGE Japanese Mobile Broadcast(ISDB-T 1seg/ISDB-Tmm 13seg) Device Support"

	  
config LGE_BROADCAST_LFULLSEG_FC8300
	bool "1Seg broacast tuner chipset fc8150 device driver"
	depends on LGE_BROADCAST_SBTVD_LATIN && (ARCH_MT6582)
	default y
	help
	  Select this if you want to use Japanese 1Seg mobile broadcast service
endmenu
```
